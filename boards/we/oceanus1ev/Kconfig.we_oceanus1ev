## boards/we/oceanus1ev/Kconfig.we_oceanus1ev
```kconfig
# Copyright (c) 2024 Würth Elektronik eiSos GmbH & Co. KG
# SPDX-License-Identifier: Apache-2.0

config BOARD_WE_OCEANUS1EV
	select SOC_STM32WLE5XX
```

## boards/we/oceanus1ev/we_oceanus1ev_defconfig
```kconfig
# enable uart driver
CONFIG_SERIAL=y

# enable GPIO
CONFIG_GPIO=y

# console
CONFIG_CONSOLE=y
CONFIG_UART_CONSOLE=y

# Enable MPU
CONFIG_ARM_MPU=y

# Enable HW stack protection
CONFIG_HW_STACK_PROTECTION=y

# Set main stack size to 2 KB
CONFIG_MAIN_STACK_SIZE=2048
```

## drivers/sensor/wsen/wsen_gcds_2526101040301/Kconfig
```kconfig
# Copyright (c) 2025 Würth Elektronik eiSos GmbH & Co. KG
# SPDX-License-Identifier: Apache-2.0

menuconfig WSEN_GCDS_2526101040301
	bool "WSEN-GCDS-2526101040301 CO2 sensor"
	default y
	depends on DT_HAS_WE_WSEN_GCDS_2526101040301_ENABLED
	select I2C
	select HAS_WESENSORS
	help
	  Enable driver for the WSEN-GCDS-2526101040301 I2C-based CO2 sensor.
```

## dts/bindings/sensor/we,wsen-gcds-2526101040301.yaml
```yaml
# Copyright (c) 2025 Würth Elektronik eiSos GmbH & Co. KG
# SPDX-License-Identifier: Apache-2.0

description: |
    Würth Elektronik WSEN-GCDS-2526101040301 CO2 sensor

compatible: "we,wsen-gcds-2526101040301"

include: [sensor-device.yaml, i2c-device.yaml]

properties:

  operation-mode:
    type: string
    default: "single-shot"
    enum:
      - "single-shot"
      - "low-power-periodic"
      - "periodic"
    description: |
      Operation mode of the sensor.
      single-shot: measurement is done when needed.
      low-power-periodic: measurement is done periodically every 30 seconds.
      periodic: measurement is done periodically every 5 seconds.

  temperature-offset:
    type: int
    description: |
      Temperature offset of the sensor in milli-degrees Celsius.
      Valid ranges are (0 - 20000).

  altitude:
    type: int
    description: |
      Altitude of the sensor in meters.
      Valid ranges are (0 - 3000).

  ambient-pressure:
    type: int
    description: |
      Ambient pressure of the sensor in Pa.
      Valid ranges are (70000 - 120000).

  automatic-self-calibration:
    type: boolean
    description: |
      State of automatic self calibration.

  automatic-self-calibration-target:
    type: int
    description: |
      Value of the automatic self calibration
      target for CO2 values in ppm.

  automatic-self-calibration-initial-period:
    type: int
    description: |
      Duration of initial period for automatic
      self calibration in hours.
      Valid values are multiples of 4.

  automatic-self-calibration-standard-period:
    type: int
    description: |
      Standard period for automatic
      self calibration in hours.
      Valid values are multiples of 4.
```

## samples/sensor/co2_polling/boards/nucleo_f401re.conf
```kconfig
CONFIG_DEBUG=y
CONFIG_NO_OPTIMIZATIONS=y
CONFIG_LOG_MODE_DEFERRED=y
CONFIG_LOG_BACKEND_UART=y
CONFIG_MAIN_STACK_SIZE=2048
CONFIG_LOG_BACKEND_SHOW_COLOR=n
CONFIG_WSEN_GCDS_2526101040301=y
```

## samples/sensor/pressure_polling/boards/nucleo_f401re.conf
```kconfig
CONFIG_DEBUG=y
CONFIG_NO_OPTIMIZATIONS=y
# CONFIG_LOG_MODE_DEFERRED=y
CONFIG_LOG_BACKEND_UART=y
CONFIG_MAIN_STACK_SIZE=2048
CONFIG_LOG_BACKEND_SHOW_COLOR=n

CONFIG_LOG=y
CONFIG_PRINTK=y
```

## samples/sensor/wsen_hids_2525020210002/sample.yaml
```yaml
sample:
  name: WSEN-HIDS-2525020210002 Sensor Sample
tests:
  sample.sensor.wsen-HIDS-2525020210002:
    harness: sensor
    tags: sensors
    depends_on: i2c
    filter: dt_compat_enabled("we,wsen-hids-2525020210002")
```
